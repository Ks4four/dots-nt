## zmk/corne-eyelash/config/west.yml
```yaml
manifest:
  remotes:
    - name: zmkfirmware
      url-base: https://github.com/zmkfirmware
    - name: urob
      url-base: https://github.com/urob
    - name: m165437
      url-base: https://github.com/M165437
    - name: robotfu
      url-base: https://github.com/robotfu
  projects:
    # --- 删除掉了 eyelash_corne 的引用，因为现在文件在本地 ---
    - name: zmk
      remote: zmkfirmware
      revision: main
      import: app/west.yml
    - name: zmk-auto-layer
      remote: urob
      revision: v0.1
    - name: zmk-leader-key
      remote: urob
      revision: v0.2
    - name: nice-view-gem
      remote: m165437
      revision: main
    # Apply patch to fix child nodes issue
    - name: zephyr
      remote: urob
      revision: v3.5.0+zmk-fixes
      clone-depth: 1
      import:
        name-blocklist:
          - ci-tools
          - hal_altera
          - hal_cypress
          - hal_infineon
          - hal_microchip
          - hal_nxp
          - hal_openisa
          - hal_silabs
          - hal_xtensa
          - hal_st
          - hal_ti
          - loramac-node
          - mcuboot
          - mcumgr
          - net-tools
          - openthread
          - edtt
          - trusted-firmware-m
  self:
    path: config
```
